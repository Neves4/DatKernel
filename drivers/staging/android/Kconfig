## drivers/staging/android/Kconfig
```kconfig
menu "Android"

config ANDROID
	bool "Android Drivers"
	default N
	---help---
	  Enable support for various drivers needed on the Android platform

if ANDROID

config ANDROID_BINDER_IPC
	bool "Android Binder IPC Driver"
	default n

config ANDROID_LOGGER
	tristate "Android log driver"
	default n

config ANDROID_PERSISTENT_RAM
	bool
	select REED_SOLOMON
	select REED_SOLOMON_ENC8
	select REED_SOLOMON_DEC8

config ANDROID_RAM_CONSOLE
	bool "Android RAM buffer console"
	depends on !S390 && !UML
	select ANDROID_PERSISTENT_RAM
	default n

config LOGCAT_SIZE
	int "Adjust android log buffer sizes"
	default 256
	depends on ANDROID_LOGGER
	help
	  Set logger buffer size. Enter a number greater than zero.
	  Any value less than 256 is recommended. Reduce value to save kernel static memory size.

config ANDROID_TIMED_OUTPUT
	bool "Timed output class driver"
	default y

config ANDROID_LMK_ADJ_RBTREE
	bool "Android Low Memory Killer: Red-Black Tree search"
	depends on ANDROID_LOW_MEMORY_KILLER
	default y
	---help---
	  Utilize RB Tree for walking the tasklist.. O(log n) vs O(n)
	  much speedier for long task list!

config ANDROID_TIMED_GPIO
	tristate "Android timed gpio driver"
	depends on GENERIC_GPIO && ANDROID_TIMED_OUTPUT
	default n

config ANDROID_LOW_MEMORY_KILLER
	bool "Android Low Memory Killer"
	default N
	---help---
	  Register processes to be killed when memory is low

endif # if ANDROID

endmenu
```
